## conf/layer.conf
```bitbake
# We have a conf and classes directory, add to BBPATH
BBPATH .= ":${LAYERDIR}"

# We have recipes-* directories, add to BBFILES
BBFILES += "${LAYERDIR}/recipes-*/*/*.bb \
            ${LAYERDIR}/recipes-*/*/*.bbappend"

BBFILE_COLLECTIONS += "meta-mios-webcam"
BBFILE_PATTERN_meta-mios-webcam = "^${LAYERDIR}/"
BBFILE_PRIORITY_meta-mios-webcam = "6"
```
